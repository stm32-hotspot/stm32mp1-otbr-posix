## meta-otbr/conf/layer.conf
```bitbake
# We have a conf and classes directory, add to BBPATH
BBPATH .= ":${LAYERDIR}"

# We have recipes-* directories, add to BBFILES
BBFILES += "${LAYERDIR}/recipes-*/*/*.bb \
            ${LAYERDIR}/recipes-*/*/*.bbappend"

BBFILE_COLLECTIONS += "meta-otbr"
BBFILE_PATTERN_meta-otbr = "^${LAYERDIR}/"
BBFILE_PRIORITY_meta-otbr = "7"

LAYERDEPENDS_meta-otbr = "core"
LAYERSERIES_COMPAT_meta-otbr = "kirkstone"

# OpenSTLinux compatibility version
ST_OSTL_COMPATIBILITY_VERSION_meta-otbr = "4.1"
```
